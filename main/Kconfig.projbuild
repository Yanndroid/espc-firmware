## main/Kconfig.projbuild
```kconfig
menu "ESP Clock Settings"

    config DEVICE_NAME
        string "Device Name"
        default "ESP Clock"
        help
            The device name which is used in the app and as wifi station name. Max 31 chars.

    config AP_PASSWORD
        string "AP Password"
        default "yanndroid"
        help
            Hotspot password for Clock setup.

    config WIFI_SSID
        string "WiFi SSID"
        default ""
        help
            Wifi ssid.

    config WIFI_PASSWORD
        string "WiFi Password"
        default ""
        help
            Wifi password.

    config WIFI_USERNAME
        string "WiFi Enterprise Username"
        default ""
        help
            Wifi username for enterprise APs.

    config BRIGHTNESS_MIN
        int "Minimum Brightness"
        default 4
        range 0 255
        help
            The brightness at night. From 0 to 255.

    config BRIGHTNESS_MAX
        int "Maximum Brightness"
        default 60
        range 0 255
        help
            The brightness at day. From 0 to 255.

    config BRIGHTNESS_MARGIN
        int "Brightness Transition Time"
        default 7200
        range 0 14400
        help
            The brightness transition time in seconds before and after sunrise/sunset. Linear transition between min and max brightness.

    config COLOR_HUE
        int "Color Hue"
        default 60000
        range 0 65535
        help
            The hue for the color, or start point for the rainbow animation. From 0 to 65535.

    config COLOR_SAT
        int "Color Saturation"
        default 255
        range 0 255
        help
            The hue for the color, or start point for the rainbow animation. From 0 to 255.
    

endmenu
```

## sdkconfig.defaults
```kconfig
CONFIG_PARTITION_TABLE_TWO_OTA=y
CONFIG_ENABLE_COAP=y
CONFIG_ESP8266_NMI_WDT=n
CONFIG_ESP_MAIN_TASK_STACK_SIZE=8192
CONFIG_ESP_TASK_WDT=n
CONFIG_HTTP_BUF_SIZE=1024
CONFIG_OTA_ALLOW_HTTP=y
CONFIG_LWIP_LOCAL_HOSTNAME="ESP Clock"
CONFIG_NEWLIB_NANO_FORMAT=n
CONFIG_MAIN_TASK_STACK_SIZE=8192
CONFIG_TASK_WDT=n
```
